## zephyr_fw/west.yml
```yaml
manifest:
  remotes:
    - name: zephyrproject
      url-base: https://github.com/zephyrproject-rtos

  projects:
    - name: zephyr
      remote: zephyrproject
      revision: v3.7.0    # Compatible with SDK 0.17.4
      import:
        name-allowlist:
          - hal_espressif   # Needed for ESP32 boards
          - cmsis
          - mbedtls

  self:
    path: zephy_fw
```
