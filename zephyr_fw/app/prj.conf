## CMakeLists.txt
```
cmake_minimum_required(VERSION 3.20.0)
find_package(Zephyr REQUIRED HINTS $ENV{ZEPHYR_BASE})
project(one_leg_robot_fw)

# Add include directories
zephyr_include_directories(include)

# Add all source files
target_sources(app PRIVATE
    src/main.c
    src/state_machine.c
    src/imu_reader.c
    src/leg_controller.c
    src/pid_controller.c
    src/safety_monitor.c
    src/serial_comm.c
)
```

## prj.conf
```kconfig
# General system settings
CONFIG_MAIN_STACK_SIZE=4096
CONFIG_HEAP_MEM_POOL_SIZE=16384
CONFIG_NEWLIB_LIBC=y
CONFIG_NEWLIB_LIBC_FLOAT_PRINTF=y
CONFIG_ASSERT=y

# Logging
CONFIG_LOG=y
CONFIG_LOG_DEFAULT_LEVEL=3

# Console over UART
CONFIG_UART_CONSOLE=y
CONFIG_SERIAL=y

# Enable Wi-Fi (optional, if you plan to use Wi-Fi for comms)
CONFIG_WIFI=y
CONFIG_WIFI_STA=y
CONFIG_NET_L2_WIFI_MGMT=y
CONFIG_NET_IPV4=y
CONFIG_NET_IPV6=n
CONFIG_NET_SOCKETS=y
CONFIG_NET_SOCKETS_POSIX_NAMES=y

# Enable mDNS (for future ROS discovery)
CONFIG_MDNS_RESOLVER=y

# Enable threading (for concurrent tasks)
CONFIG_THREAD_MONITOR=y
```

## src/main.c
```c
#include <zephyr/device.h>
#include <zephyr/drivers/gpio.h>
#include <zephyr/drivers/uart.h>
#include <zephyr/kernel.h>

#include "config.h"
#include "imu_reader.h"
#include "leg_controller.h"
#include "motor_control.h"
#include "pid_controller.h"
#include "safety_monitor.h"
#include "serial_comm.h"
#include "state_machine.h"

// ===============================================================
// THREAD PERIODS (tunable)
// ===============================================================
#define IMU_PERIOD_MS 1      // 1000 Hz
#define CONTROL_PERIOD_MS 1  // 1000 Hz
#define SERIAL_PERIOD_MS 5   // 200 Hz
#define SAFETY_PERIOD_MS 10  // 100 Hz

// ===============================================================
// THREAD STACKS & PRIORITIES
// (higher number = *lower* priority in Zephyr)
// ===============================================================

K_THREAD_STACK_DEFINE(imu_stack, 2048);
K_THREAD_STACK_DEFINE(control_stack, 2048);
K_THREAD_STACK_DEFINE(serial_stack, 2048);
K_THREAD_STACK_DEFINE(safety_stack, 2048);

static struct k_thread imu_thread;
static struct k_thread control_thread;
static struct k_thread serial_thread;
static struct k_thread safety_thread;

// Forward declarations
void imu_task(void*, void*, void*);
void control_task(void*, void*, void*);
void serial_task(void*, void*, void*);
void safety_task(void*, void*, void*);

// ===============================================================
// MAIN ENTRY POINT
// ===============================================================
void main(void) {
  printk("\n=== Humanoid Robot Firmware Booting ===\n");

  // -----------------------------------------------------------
  // 1. Hardware Initialization (MUST come first)
  // -----------------------------------------------------------
  init_hardware();  // GPIO, UART, timers, PWM, ADC, anything electrical

  // -----------------------------------------------------------
  // 2. Initialize all subsystem modules
  //    (NO module initializes inside another module!)
  // -----------------------------------------------------------
  init_imu_reader();
  init_motor_control();
  init_leg_controller();
  init_pid_controller();  // if needed
  init_state_machine();
  init_safety_monitor();
  init_serial_comm();

  printk("Initialization complete. Launching threads...\n");

  // -----------------------------------------------------------
  // 3. Create periodic real-time threads
  // -----------------------------------------------------------

  // IMU Thread (highest priority)
  k_thread_create(&imu_thread, imu_stack, K_THREAD_STACK_SIZEOF(imu_stack),
                  imu_task, NULL, NULL, NULL, 1, 0, K_NO_WAIT);

  // Control Thread (same high priority)
  k_thread_create(&control_thread, control_stack,
                  K_THREAD_STACK_SIZEOF(control_stack), control_task, NULL,
                  NULL, NULL, 1, 0, K_NO_WAIT);

  // Serial Comm Thread (medium priority)
  k_thread_create(&serial_thread, serial_stack,
                  K_THREAD_STACK_SIZEOF(serial_stack), serial_task, NULL, NULL,
                  NULL, 3, 0, K_NO_WAIT);

  // Safety Monitor Thread (high but less than control)
  k_thread_create(&safety_thread, safety_stack,
                  K_THREAD_STACK_SIZEOF(safety_stack), safety_task, NULL, NULL,
                  NULL, 2, 0, K_NO_WAIT);

  printk("All threads created.\n");

  // -----------------------------------------------------------
  // 4. MAIN LOOP (lowest priority)
  // -----------------------------------------------------------
  while (1) {
    // Heartbeat LED or low-frequency diagnostics
    k_sleep(K_MSEC(1000));
  }
}

// ===============================================================
// THREAD IMPLEMENTATIONS
// ===============================================================

void imu_task(void* a, void* b, void* c) {
  while (1) {
    imu_update();  // you will implement this in imu_reader.c
    k_sleep(K_MSEC(IMU_PERIOD_MS));
  }
}

void control_task(void* a, void* b, void* c) {
  while (1) {
    // Step 1: Get the desired torque from leg controller
    LegControlOutput cmd = leg_controller_update();

    // Step 2: Pass to motor control (which applies PID + PWM)
    motor_control_apply(cmd);

    k_sleep(K_MSEC(CONTROL_PERIOD_MS));
  }
}

void serial_task(void* a, void* b, void* c) {
  while (1) {
    serial_comm_update();
    k_sleep(K_MSEC(SERIAL_PERIOD_MS));
  }
}

void safety_task(void* a, void* b, void* c) {
  while (1) {
    safety_monitor_check();
    k_sleep(K_MSEC(SAFETY_PERIOD_MS));
  }
}
```

## include/motor_control.h
```c
#ifndef MOTOR_CONTROL_H
#define MOTOR_CONTROL_H

#include <stdint.h>

// Motor state structure
typedef struct {
    float position;   // encoder position
    float velocity;   // computed velocity
    float current;    // motor current in amperes
    float torque;     // motor torque
} MotorState;

// Leg control output structure (from leg_controller)
typedef struct {
    float desired_torque;
} LegControlOutput;

// Initialize motor control subsystem
void init_motor_control(void);

// Apply motor control command
void motor_control_apply(LegControlOutput cmd);

// Get current motor state
MotorState get_motor_state(void);

// Disable motors (for safety)
void disable_motors(void);

#endif
```

## include/safety_monitor.h
```c
#ifndef SAFETY_MONITOR_H
#define SAFETY_MONITOR_H

#include <stdbool.h>

// Initialize safety monitor
void init_safety_monitor(void);

// Main safety check function (called by thread)
void safety_monitor_check(void);

// Enter failsafe mode
void enter_failsafe(void);

// Global fault flag
extern bool fault_detected;

#endif
```

## include/state_machine.h
```c
#ifndef STATE_MACHINE_H
#define STATE_MACHINE_H

#include <stdbool.h>
#include <stdint.h>

// Low-level robot motion modes
typedef enum {
  MODE_INIT = 0,
  MODE_STAND,
  MODE_HOP,
  MODE_LAND,
  MODE_FAILSAFE
} RobotMode;

// External API (called ONLY from main.c)
void init_state_machine(void);

// Called by serial (ROS requests) OR other firmware modules
void state_machine_update(RobotMode request);

// Read current mode safely
RobotMode get_current_mode(void);

// Internal transitions (used by safety monitor)
void state_machine_force_failsafe(void);

#endif
```

## src/motor_control.c
```c
#include <zephyr/kernel.h>
#include <zephyr/sys/printk.h>

#include "motor_control.h"
#include "pid_controller.h"

// PWM frequency: 20 kHz
#define PWM_FREQ_HZ 20000

// Global motor state
MotorState motor_state;

// Hardware abstraction layer (placeholders)
void setup_pwm_channels(void) {
    // TODO: Configure PWM hardware at 20 kHz
    printk("PWM channels initialized\n");
}

void setup_current_sensors(void) {
    // TODO: Configure ADC for current sensing
    printk("Current sensors initialized\n");
}

float read_encoder(void) {
    // TODO: Read actual encoder value
    return 0.0f;
}

float compute_velocity(void) {
    // TODO: Compute velocity from encoder readings
    return 0.0f;
}

float read_current_sensor(void) {
    // TODO: Read ADC value and convert to amperes
    return 0.0f;
}

float torque_to_pwm(float torque) {
    // TODO: Convert torque to PWM duty cycle (0-100%)
    // This conversion depends on motor specs
    return 0.0f;
}

void set_motor_pwm(float pwm_duty) {
    // TODO: Set actual PWM duty cycle
    // Clamp to 0-100%
    if (pwm_duty > 100.0f) pwm_duty = 100.0f;
    if (pwm_duty < 0.0f) pwm_duty = 0.0f;
}

void init_motor_control(void) {
    setup_pwm_channels();
    setup_current_sensors();
    motor_state.torque = 0;
}

void motor_control_apply(LegControlOutput cmd) {
    // Convert desired torque into motor current or PWM duty
    float pwm_duty = torque_to_pwm(cmd.desired_torque);
    set_motor_pwm(pwm_duty);

    // Read motor feedback
    motor_state.position = read_encoder();
    motor_state.velocity = compute_velocity();
    motor_state.current  = read_current_sensor();
}

MotorState get_motor_state(void) {
    return motor_state;
}

void disable_motors(void) {
    // Set PWM to zero to stop motor
    set_motor_pwm(0.0f);
    motor_state.torque = 0;
    printk("Motors disabled\n");
}
```

## src/safety_monitor.c
```c
#include <zephyr/kernel.h>
#include <zephyr/sys/printk.h>
#include <math.h>

#include "safety_monitor.h"
#include "motor_control.h"
#include "imu_reader.h"
#include "state_machine.h"

// Safety thresholds
#define MAX_SAFE_TILT 45.0f      // degrees
#define MAX_SAFE_CURRENT 5.0f    // amperes

// Watchdog timeout
#define WATCHDOG_TIMEOUT_MS 500

// Global fault flag
bool fault_detected = false;

// Watchdog timer
static struct k_timer watchdog_timer;

// Watchdog callback (called when timer expires)
void watchdog_expired(struct k_timer *timer) {
    printk("Watchdog timeout!\n");
    fault_detected = true;
    enter_failsafe();
}

void init_safety_monitor(void) {
    k_timer_init(&watchdog_timer, watchdog_expired, NULL);
    k_timer_start(&watchdog_timer, K_MSEC(WATCHDOG_TIMEOUT_MS), K_MSEC(WATCHDOG_TIMEOUT_MS));
}

void safety_monitor_check(void) {
    // Get IMU data (placeholder - assumes these functions exist)
    IMUData imu = get_imu_data();
    
    // Get motor state (placeholder - assumes these functions exist)
    MotorState motor = get_motor_state();
    
    // Check safety conditions
    if (fabs(imu.pitch) > MAX_SAFE_TILT ||
        fabs(motor.current) > MAX_SAFE_CURRENT) {
        fault_detected = true;
        enter_failsafe();
    }
    
    // Feed the watchdog to prevent timeout
    k_timer_start(&watchdog_timer, K_MSEC(WATCHDOG_TIMEOUT_MS), K_MSEC(WATCHDOG_TIMEOUT_MS));
}

void enter_failsafe(void) {
    // Disable motors (placeholder - assumes this function exists)
    disable_motors();
    
    // Update state machine to failsafe mode
    state_machine_update(MODE_FAILSAFE);
    
    // Log error
    printk("Failsafe triggered!\n");
}
```

## src/state_machine.c
```c
#include "state_machine.h"

#include <zephyr/kernel.h>

static RobotMode current_mode = MODE_INIT;

// ============================================================
// INITIALIZATION
// ============================================================
void init_state_machine(void) { current_mode = MODE_INIT; }

// ============================================================
// INTERNAL HELPER FOR SAFE TRANSITIONS
// ============================================================
static void transition_to(RobotMode new_mode) {
  // Optional: add logging later
  // printk("STATE: %d -> %d\n", current_mode, new_mode);
  current_mode = new_mode;
}

// ============================================================
// MAIN STATE MACHINE UPDATE
// (Called when: serial commands OR internal triggers occur)
// ============================================================
void state_machine_update(RobotMode request) {
  switch (current_mode) {
    case MODE_INIT:
      if (request == MODE_STAND) {
        transition_to(MODE_STAND);
      }
      break;

    case MODE_STAND:
      if (request == MODE_HOP) {
        transition_to(MODE_HOP);
      } else if (request == MODE_INIT) {
        transition_to(MODE_INIT);
      }
      break;

    case MODE_HOP:
      // Landing is automatically detected by IMU in leg controller
      if (request == MODE_LAND) {
        transition_to(MODE_LAND);
      }
      break;

    case MODE_LAND:
      if (request == MODE_STAND) {
        transition_to(MODE_STAND);
      }
      break;

    case MODE_FAILSAFE:
      // stays locked unless INIT explicitly sent
      if (request == MODE_INIT) {
        transition_to(MODE_INIT);
      }
      break;

    default:
      transition_to(MODE_FAILSAFE);
      break;
  }
}

// ============================================================
// FORCE FAILSAFE (from safety_monitor.c)
// ============================================================
void state_machine_force_failsafe(void) { transition_to(MODE_FAILSAFE); }

// ============================================================
// GET CURRENT MODE
// ============================================================
RobotMode get_current_mode(void) { return current_mode; }
```
